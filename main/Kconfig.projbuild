## main/Kconfig.projbuild
```kconfig
menu "LinSight"

    choice LINSIGHT_CAN_MODE
        prompt "Default CAN mode"
        default LINSIGHT_CAN_MODE_LISTEN_ONLY
        help
            LISTEN_ONLY never transmits and is safe on unknown buses.
            NORMAL ACKs frames; use it only on a bench where the device
            is the second node.

    config LINSIGHT_CAN_MODE_LISTEN_ONLY
        bool "Listen-only"

    config LINSIGHT_CAN_MODE_NORMAL
        bool "Normal (ACKs the bus)"

    endchoice

    config LINSIGHT_WIFI_SSID
        string "Wi-Fi SSID"
        default "20pro"
        help
            Station SSID. The default is the bench hotspot; override it in
            menuconfig for production builds.

    config LINSIGHT_WIFI_PASSWORD
        string "Wi-Fi password"
        default "88888888"
        help
            Leave empty for an open network.

    config LINSIGHT_HOST_IP
        string "Host IPv4 address"
        default "10.75.237.181"
        help
            Fallback address of the PC running linsightd when UDP discovery
            is disabled or gets no reply. Also the primary endpoint when
            discovery is disabled.

    config LINSIGHT_HOST_PORT
        int "Host TCP port"
        range 1 65535
        default 8888
        help
            Fallback TCP port. When discovery succeeds, the reply carries
            the port configured in linsightd (--port).

    config LINSIGHT_DISCOVERY
        bool "Discover linsightd over UDP broadcast"
        default y
        help
            Probe the LAN for linsightd so a changed host IP does not
            require rebuilding the firmware. The probe is sent to UDP
            LINSIGHT_DISCOVERY_PORT; the reply supplies the host address
            and TCP port. On failure the firmware falls back to
            LINSIGHT_HOST_IP/LINSIGHT_HOST_PORT.

    config LINSIGHT_DISCOVERY_PORT
        int "Discovery UDP port"
        range 1 65535
        default 8889
        depends on LINSIGHT_DISCOVERY
        help
            Must match linsightd --discovery-port (default 8889).

endmenu
```
